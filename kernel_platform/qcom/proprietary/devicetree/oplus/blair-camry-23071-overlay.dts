/dts-v1/;
/plugin/;

#include "blair-camry-overlay-common.dtsi"
#include "oplus_chg/oplus-chg-23071.dtsi"
#include "sensor/camry-sensor-23071.dtsi"
#include <dt-bindings/oplus/hw-id.h>

/ {
	model = "Qualcomm Technologies, Inc. Blair QRD NOPMI,camry 23071";
	oplus,project-id = <23071>;
	oplus,hw-id = <OPLUS_DVT1 OPLUS_PVT1>;
};
