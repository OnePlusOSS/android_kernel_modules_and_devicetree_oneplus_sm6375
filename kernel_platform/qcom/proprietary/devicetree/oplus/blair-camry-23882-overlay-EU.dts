/dts-v1/;
/plugin/;

#include "blair-camry-overlay-common.dtsi"
#include "oplus_chg/oplus-chg-23881-EU.dtsi"
#include "sensor/camry-sensor-23071.dtsi"
#include "nfc/camry-23882-nfc-pn560.dtsi"
#include <dt-bindings/oplus/hw-id.h>

/ {
	model = "Qualcomm Technologies, Inc. Blair QRD NOPMI,camry europe (Reduced battery capacity) 23882";
	oplus,project-id = <23881>;
	oplus,region-id = <3>;
	oplus,hw-id = <OPLUS_DVT1 OPLUS_EVT1 OPLUS_PVT1>;
	oplus,nv-id = "01000100";
};
