/dts-v1/;
/plugin/;

#include "blair-camry-overlay-common.dtsi"
#include "oplus_chg/oplus-chg-23881.dtsi"
#include "sensor/camry-sensor-23071.dtsi"
#include "display/camry-23071-display-overlay-EVT1.dtsi"
#include <dt-bindings/oplus/hw-id.h>

/ {
	model = "Qualcomm Technologies, Inc. Blair QRD NOPMI,camry india 23881 EVT1";
	oplus,project-id = <23881>;
	oplus,region-id = <2>;
	oplus,hw-id = <OPLUS_EVT1>;
};
