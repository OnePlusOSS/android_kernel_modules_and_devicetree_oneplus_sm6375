/dts-v1/;
/plugin/;
//#include <dt-bindings/oplus/hw-id.h>
#include "../blair-audio-mtp.dts"
#include "blair_audio_overlay_common.dtsi"
#include "larry_22821_audio_overlay_common.dtsi"
/ {
        oplus,project-id = <22821 22871 22872 22874>;
        //oplus,hw-id = <OPLUS_EVB1 OPLUS_T0 OPLUS_EVT1 OPLUS_EVT2 OPLUS_DVT1 OPLUS_PVT1 OPLUS_MP1>;
};
