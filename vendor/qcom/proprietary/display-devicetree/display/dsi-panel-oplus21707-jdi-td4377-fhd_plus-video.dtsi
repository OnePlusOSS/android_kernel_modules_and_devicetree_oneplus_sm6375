&mdss_mdp {
	dsi_oplus21707_jdi_td4377_fhd_plus_video: qcom,mdss_dsi_oplus21707_jdi_td4377_fhd_plus_video {
		qcom,mdss-dsi-panel-name =
			"jdi td4377 21707 fhd plus mipi panel with DSC";
		qcom,mdss-dsi-panel-type = "dsi_video_mode";
		qcom,dsi-ctrl-num = <0>;
		qcom,dsi-phy-num = <0>;
		qcom,mdss-dsi-virtual-channel-id = <0>;
		qcom,mdss-dsi-stream = <0>;
		qcom,mdss-dsi-bpp = <24>;
		qcom,mdss-dsi-color-order = "rgb_swap_rgb";
		qcom,mdss-dsi-underflow-color = <0xff>;
		qcom,mdss-dsi-border-color = <0>;

		qcom,mdss-dsi-traffic-mode = "burst_mode";
		qcom,mdss-dsi-bllp-power-mode;
		qcom,mdss-dsi-bllp-eof-power-mode;
		qcom,mdss-dsi-lane-0-state;
		qcom,mdss-dsi-lane-1-state;
		qcom,mdss-dsi-lane-2-state;
		qcom,mdss-dsi-lane-3-state;
		qcom,mdss-dsi-dma-trigger = "trigger_sw";
		qcom,mdss-dsi-mdp-trigger = "none";
		qcom,mdss-dsi-reset-sequence = <1 5>, <0 5>, <1 20>;

		qcom,mdss-dsi-wr-mem-start = <0x2C>;
		qcom,mdss-dsi-wr-mem-continue = <0x3C>;

		qcom,bl-update-flag = "delay_until_first_frame";
		qcom,mdss-dsi-init-delay-us = <1000>;
		qcom,mdss-dsi-lp11-init;
		qcom,ulps-enabled;
		qcom,suspend-ulps-enabled;

		qcom,mdss-dsi-te-pin-select = <1>;
		qcom,mdss-dsi-te-dcs-command = <1>;
		qcom,mdss-dsi-te-check-enable;
		qcom,mdss-dsi-te-using-te-pin;

		qcom,mdss-pan-physical-width-dimension = <71>;
		qcom,mdss-pan-physical-height-dimension = <152>;

		qcom,mdss-dsi-display-timings {
			timing@0 {
				//qcom,mdss-mdp-transfer-time-us = <7000>;
				qcom,mdss-dsi-panel-framerate = <120>;
				qcom,mdss-dsi-panel-width = <1080>;
				qcom,mdss-dsi-panel-height = <2412>;
				qcom,mdss-dsi-h-front-porch = <40>;
				qcom,mdss-dsi-h-back-porch = <30>;
				qcom,mdss-dsi-h-pulse-width = <6>;
				qcom,mdss-dsi-h-sync-skew = <0>;
				qcom,mdss-dsi-v-back-porch = <12>;
				qcom,mdss-dsi-v-front-porch = <70>;
				qcom,mdss-dsi-v-pulse-width = <6>;
				qcom,mdss-dsi-on-command = [
					29 01 00 00 00 00 02 B0 00
					29 01 00 00 00 00 02 D6 00
					29 01 00 00 00 00 0B B6 30 6B 00 86 13 0A 13 1A 00 00
					29 01 00 00 00 00 05 B7 51 00 00 00
					29 01 00 00 00 00 08 B8 11 56 0B BE 1E 1E 0A
					29 01 00 00 00 00 08 B9 21 5C 0D BE 3C 63 0A
					29 01 00 00 00 00 08 BA 31 60 10 BE 64 6E 0A
					29 01 00 00 00 00 0C BB 44 26 C3 1F 19 06 03 C0 00 00 10
					29 01 00 00 00 00 0C BC 32 4C C3 52 32 1F 03 F2 00 00 13
					29 01 00 00 00 00 0C BD 24 68 C3 AA 3F 32 03 FF 00 00 25
					29 01 00 00 00 00 0D BE 00 00 00 00 00 00 00 00 00 00 00 00
					29 01 00 00 00 00 24 C0 00 5B 01 2C 08 09 6C 00 08 22 00 08 00 70 00 00 00 00 00 00 00 00 02 01 2C 01 2C 01 2C 00 00 00 00 00 00
					29 01 00 00 00 00 60 C1 30 00 00 21 00 00 00 00 22 00 05 20 00 80 FA 40 00 84 0F 00 00 00 00 00 00 00 00 00 00 00 00 00 00 00 00 00 00 00 00 00 00 01 2C 08 08 00 0A 28 0F 3C 14 50 00 00 00 00 00 00 00 03 00 FF F5 84 7A A0 00 00 00 00 00 00 00 00 00 00 00 00 00 00 00 00 00 00 00 00 00 00 00 00 00 00 00 01 00
					29 01 00 00 00 00 A0 C2 02 C0 2C 01 03 10 02 00 00 00 00 00 00 00 00 00 00 00 00 00 00 00 00 00 00 00 00 00 00 00 00 00 00 00 00 00 00 00 00 00 00 00 00 00 00 00 11 00 00 00 00 00 00 01 D0 47 00 00 00 00 C0 00 00 00 00 00 01 00 00 00 00 00 11 00 00 00 00 00 00 00 00 00 00 00 00 00 00 00 00 00 00 00 00 00 00 00 11 00 00 00 00 00 00 00 00 4F 00 00 00 00 C0 00 00 04 00 00 00 00 00 00 11 00 00 04 00 00 00 00 00 00 00 00 00 00 00 00 00 00 00 00 00 00 00 00 00 00 00 00 00 00 00 00 00 00 00 00 00 00 00
					29 01 00 00 00 00 6D C3 00 00 00 00 00 00 00 00 00 00 00 00 00 00 00 00 00 00 00 00 00 00 00 00 00 00 00 00 00 00 00 00 00 00 00 00 00 00 00 00 00 00 00 00 00 00 00 00 00 00 00 00 00 00 00 00 00 00 00 00 00 00 AA AA AA 00 00 00 00 00 00 00 00 00 00 00 00 00 00 00 00 00 00 00 00 00 00 00 00 00 00 00 00 00 00 00 00 00 00 00 00 00 00 00 00 00 00 00
					29 01 00 00 00 00 7B C4 00 00 00 00 00 62 60 5E 00 5F 5D 61 00 4C 00 3F 00 83 00 00 87 86 85 84 00 00 00 00 00 62 60 5E 00 5F 5D 61 00 00 00 02 00 83 00 00 87 86 85 84 FF FF FF FF FF FF 00 0E F0 00 0E F0 00 00 00 00 00 00 E0 0E 00 E0 0E 00 00 00 00 00 00 00 00 00 00 00 00 00 00 00 00 00 09 59 00 1F 51 0D 1F 71 0D 00 00 00 00 00 00 00 00 00 00 00 00 00 70 07 00 70 07 00 70 07 00 70 07 00
					29 01 00 00 00 00 06 C5 08 00 00 00 00
					29 01 00 00 00 00 51 C6 02 0A 00 F3 FF FF FF 00 30 13 01 FF 0F 01 03 1A 1B 17 00 00 00 01 05 0A 2C 2C 01 03 1E 19 17 01 0B 00 00 00 1E 01 00 00 00 00 00 00 20 20 00 00 12 00 00 00 00 00 22 22 00 00 00 00 10 00 01 00 00 00 00 01 00 00 00 00 01 00 00 00 00 05 00 1F
					29 01 00 00 00 00 10 CB 20 80 70 00 20 00 00 2D 41 00 00 00 00 00 FF
					29 01 00 00 00 00 02 CD 00
					29 01 00 00 00 00 24 CE 5D 40 49 53 59 5E 63 68 6E 74 7E 8A 98 A8 BB D0 E7 FF 01 19 04 04 42 44 69 5A 40 40 00 00 00 84 FA 00 00
					29 01 00 00 00 00 07 CF 89 00 80 46 61 00
					29 01 00 00 00 00 13 D0 CC 15 D5 66 09 B0 00 CF CF E5 D4 0A 52 FE 09 09 CF 00
					29 01 00 00 00 00 37 D1 D3 D3 1B B0 07 07 3B 33 33 33 33 05 33 7B 07 33 3B 78 D2 D2 06 96 13 93 22 22 22 B3 BB 00 00 BB BB 11 08 08 84 00 09 77 FF 11 44 11 01 11 01 44 04 44 04 77 77 77
					29 01 00 00 00 00 03 D2 00 00
					29 01 00 00 00 00 18 D4 00 00 00 00 00 00 00 00 00 00 00 00 00 00 00 00 00 00 00 00 00 00 00
					29 01 00 00 00 00 4B D7 21 10 52 52 00 5B 00 08 00 5B 04 FD 01 00 03 00 05 05 00 03 04 05 00 04 00 08 02 08 06 03 08 04 08 08 0C 0B 0A 0A 0A 07 08 0A 06 00 08 00 04 05 09 00 04 04 04 04 04 04 04 02 04 04 04 04 04 04 04 04 04 04 06 06 05 05 05 00
					29 01 00 00 00 00 17 D9 40 97 26 ED 0E BA 16 6C 16 6C 00 30 00 14 00 14 00 0C 00 00 01 00
					29 01 00 00 00 00 05 DD 30 06 23 65
					29 01 00 00 00 00 0B DE 00 00 00 0F FF 00 00 00 00 10
					29 01 00 00 00 00 0B E6 00 00 00 00 00 00 00 00 00 00
					29 01 00 00 00 00 5C E7 11 00 89 30 80 09 6C 04 38 00 0C 02 1C 02 1C 02 00 02 0E 20 01 1F 00 07 0C 08 BB 08 7A 18 00 10 F0 03 0C 20 00 06 0B 0B 33 0E 1C 2A 38 46 54 62 69 70 77 79 7B 7D 7E 01 02 01 00 09 40 09 BE 19 FC 19 FA 19 F8 1A 38 1A 78 1A B6 2A F6 2B 34 2B 74 3B 74 6B F4 00 00 00 00 00 00
					29 01 00 00 00 00 05 E8 00 31 03 00
					29 01 00 00 00 00 26 EA 01 04 1E 80 25 C0 00 00 09 00 05 B3 00 00 00 00 00 00 00 00 04 C2 00 12 00 5B 05 B0 86 00 00 00 00 00 00 00 00
					29 01 00 00 00 00 08 EB 00 00 00 00 01 00 11
					29 01 00 00 00 00 0B EC 07 30 00 12 03 25 C0 00 02 3A
					29 01 00 00 00 00 21 ED 01 01 02 02 03 03 04 04 00 00 00 00 03 00 00 00 00 00 00 00 00 00 00 D0 00 00 00 00 00 EC 10 00
					29 01 00 00 00 00 64 EE 01 0F 00 00 00 00 00 1F 00 00 0F 02 3F 00 00 00 00 00 00 00 00 00 00 00 00 00 00 00 10 01 00 09 01 00 00 00 00 00 00 00 00 00 00 00 00 00 00 00 00 00 00 00 00 00 50 1F 00 00 00 00 00 00 00 00 00 00 00 00 00 00 00 00 00 00 00 00 00 00 00 00 00 00 00 00 00 00 00 00 00 00 00 00 00 00 00 00 00 00 00
					29 01 00 00 00 00 6D EF 00 50 1F 03 90 00 00 00 00 15 15 15 00 00 00 00 00 00 00 00 00 00 B0 21 03 70 11 11 11 00 00 00 00 00 00 10 01 10 01 00 10 00 10 00 0A 06 00 00 00 00 00 43 00 03 51 00 00 05 00 00 00 00 00 00 00 00 00 00 00 00 00 00 00 00 00 00 00 00 00 00 01 00 01 00 00 00 00 00 00 00 00 00 00 00 00 00 00 00 00 00 00 00 00 00 00 00 00 00
					29 01 00 00 00 00 02 B0 04
					29 01 00 00 00 00 08 F9 44 3F 00 8D BF 00 00
					29 01 00 00 00 00 02 B0 03
					39 01 00 00 00 00 03 51 00 00
					39 01 00 00 00 00 02 53 2C
					39 01 00 00 00 00 02 55 00
					29 01 00 00 00 00 02 35 00
					05 01 00 00 3F 00 01 11
					05 01 00 00 03 00 01 29
					];
				qcom,mdss-dsi-off-command = [
					05 01 00 00 14 00 01 28
					05 01 00 00 53 00 01 10];
				qcom,mdss-dsi-cabc-off-command = [
					15 01 00 00 00 00 02 55 00];
				qcom,mdss-dsi-cabc-ui-command = [
					15 01 00 00 00 00 02 55 01];
				qcom,mdss-dsi-cabc-still-image-command = [
					15 01 00 00 00 00 02 55 02];
				qcom,mdss-dsi-cabc-video-command = [
					15 01 00 00 00 00 02 55 03];

				qcom,mdss-dsi-on-command-state = "dsi_lp_mode";
				qcom,mdss-dsi-off-command-state = "dsi_lp_mode";
				qcom,mdss-dsi-post-panel-on-command-state="dsi_lp_mode";
				qcom,mdss-dsi-cabc-off-command-state = "dsi_lp_mode";
				qcom,mdss-dsi-cabc-ui-command-state = "dsi_lp_mode";
				qcom,mdss-dsi-cabc-still-image-command-state = "dsi_lp_mode";
				qcom,mdss-dsi-cabc-video-command-state = "dsi_lp_mode";

				qcom,compression-mode = "dsc";
				qcom,mdss-dsc-slice-height = <12>;
				qcom,mdss-dsc-slice-width = <540>;
				qcom,mdss-dsc-slice-per-pkt = <2>;
				qcom,mdss-dsc-bit-per-component = <8>;
				qcom,mdss-dsc-bit-per-pixel = <8>;
				qcom,mdss-dsc-block-prediction-enable;
			};
		};
	};
};

&dsi_oplus21707_jdi_td4377_fhd_plus_video {
	oplus,mdss-dsi-manufacture = "JDI_TD4377";
	oplus,mdss-dsi-vendor-name = "TD4377";
	oplus,mdss-dsi-pre-bl-delay-enabled;
	oplus,mdss-dsi-pre-bl-delay-ms = <30>;
	oplus,mdss-dsi-cabc-enabled;
	oplus,mdss-dsi-lp-config-flag;
	oplus,lcd_switch_enabled;
	oplus,dfps-idle-off;
	qcom,panel-supply-entries = <&dsi_panel_pwr_supply_labibb>;
	qcom,mdss-dsi-bl-pmic-control-type = "bl_ctrl_dcs";
	qcom,mdss-dsi-bl-min-level = <22>;
	qcom,mdss-dsi-bl-max-level = <4095>;
	qcom,mdss-brightness-max-level = <4095>;
	qcom,mdss-dsi-bl-normal-max-level = <3420>;
	qcom,mdss-brightness-normal-max-level = <3420>;
	qcom,mdss-brightness-default-level = <1801>;
	qcom,platform-te-gpio = <&tlmm 23 0>;
	qcom,platform-reset-gpio = <&tlmm 100 0>;
	qcom,platform-reset-gpio-always-on;
	qcom,platform-tp-reset-gpio = <&tlmm 21 0>;
	qcom,dsi-select-clocks = "mux_byte_clk0", "mux_pixel_clk0",
		"src_byte_clk0", "src_pixel_clk0",
		"shadow_byte_clk0", "shadow_pixel_clk0";

	qcom,esd-check-enabled;
	qcom,mdss-dsi-panel-status-check-mode = "reg_read";
	qcom,mdss-dsi-panel-status-command = [06 01 00 01 00 00 01 0A];
	qcom,mdss-dsi-panel-status-command-state = "dsi_lp_mode";
	qcom,mdss-dsi-panel-status-value = <0x1C>;
	qcom,mdss-dsi-panel-status-read-length = <1>;

	qcom,mdss-dsi-pan-enable-dynamic-fps;
	qcom,mdss-dsi-pan-fps-update = "dfps_immediate_porch_mode_vfp";
	qcom,dsi-supported-dfps-list = <120 90 60 50 48 30>;
	qcom,mdss-dsi-qsync-min-refresh-rate = <30>;

	//qcom,dsi-dyn-clk-enable;
	//qcom,dsi-dyn-clk-type = "constant-fps-adjust-hfp";
	//qcom,dsi-dyn-clk-list = <1107046080 1117009376>;

	oplus,dsi-brightness-remapping = <21    0>,
            <22    13>,
            <246   60>,
            <688   130>,
            <920   200>,
            <1096  295>,
            <1244  390>,
            <1373  484>,
            <1489  578>,
            <1596  673>,
            <1694  767>,
            <1786  862>,
            <1872  956>,
            <1954  1051>,
            <2032  1145>,
            <2107  1240>,
            <2178  1334>,
            <2247  1429>,
            <2313  1523>,
            <2377  1618>,
            <2440  1712>,
            <2500  1807>,
            <2559  1901>,
            <2616  1996>,
            <2671  2090>,
            <2725  2185>,
            <2778  2279>,
            <2830  2374>,
            <2881  2468>,
            <2930  2553>,
            <2979  2637>,
            <3027  2729>,
            <3074  2810>,
            <3119  2900>,
            <3165  2980>,
            <3209  3060>,
            <3253  3140>,
            <3320  3260>,
            <3420  3420>,
            <4095  4095>;

	qcom,mdss-dsi-t-clk-post = <0x0F>;
	qcom,mdss-dsi-t-clk-pre = <0x1E>;
	qcom,mdss-dsi-display-timings {
		timing@0 {
			qcom,mdss-dsi-panel-phy-timings = [00 24 0A 0A 1A 18 0A
				0A 0A 09 02 04 1E 0F];
			qcom,display-topology = <1 1 1>;
			qcom,default-topology-index = <0>;
		};
	};
};

&dsi_oplus21707_jdi_td4377_fhd_plus_video {
	qcom,panel_voltage_vddi_name = "vddio";
	qcom,panel_voltage_vddi = <0 1650000 1800000 1950000>;
	qcom,panel_voltage_vddr_name = "vddio";
	qcom,panel_voltage_vddr = <1 1650000 1800000 1950000>;
};

