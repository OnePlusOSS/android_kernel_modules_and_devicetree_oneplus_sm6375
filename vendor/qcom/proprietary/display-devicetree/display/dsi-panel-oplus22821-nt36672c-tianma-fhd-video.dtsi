&mdss_mdp {
	dsi_oplus22821_nt36672c_tianma_fhd_video: qcom,mdss_dsi_oplus22821_nt36672c_tianma_fhd_video {
		qcom,mdss-dsi-panel-name =
			"nt36672c video mode dsi fhd 1080 panel";
		qcom,mdss-dsi-panel-type = "dsi_video_mode";

		qcom,dsi-ctrl-num = <0>;
		qcom,dsi-phy-num = <0>;
		qcom,mdss-dsi-virtual-channel-id = <0>;
		qcom,mdss-dsi-stream = <0>;
		qcom,mdss-dsi-h-left-border = <0>;
		qcom,mdss-dsi-h-right-border = <0>;
		qcom,mdss-dsi-v-top-border = <0>;
		qcom,mdss-dsi-v-bottom-border = <0>;
		qcom,mdss-dsi-bpp = <24>;
		qcom,mdss-dsi-color-order = "rgb_swap_rgb";
		qcom,mdss-dsi-underflow-color = <0xff>;
		qcom,mdss-dsi-border-color = <0>;
		qcom,mdss-dsi-h-sync-pulse = <0>;
		qcom,mdss-dsi-traffic-mode = "non_burst_sync_event";
		qcom,mdss-dsi-lane-map = "lane_map_0123";
		qcom,mdss-dsi-bllp-eof-power-mode;
		qcom,mdss-dsi-bllp-power-mode;
		qcom,mdss-dsi-tx-eot-append;
		qcom,mdss-dsi-lane-0-state;
		qcom,mdss-dsi-lane-1-state;
		qcom,mdss-dsi-lane-2-state;
		qcom,mdss-dsi-lane-3-state;
		qcom,mdss-dsi-dma-trigger = "trigger_sw";
		qcom,mdss-dsi-mdp-trigger = "none";
		qcom,mdss-dsi-lp11-init;
		qcom,mdss-dsi-bl-pmic-control-type = "bl_ctrl_dcs";
		qcom,mdss-dsi-bl-min-level = <1>;
		qcom,mdss-dsi-bl-normal-max-level = <3276>;
		qcom,mdss-dsi-bl-max-level = <4095>;
		qcom,mdss-brightness-normal-max-level = <3276>;
		qcom,mdss-brightness-max-level = <4095>;
		qcom,mdss-brightness-default-level = <400>;
		qcom,mdss-dsi-reset-sequence = <1 10>, <0 10>, <1 10>;
		qcom,mdss-pan-physical-width-dimension = <70>;
		qcom,mdss-pan-physical-height-dimension = <156>;
		oplus,mdss-dsi-vendor-name = "NT36672C-90HZ";
		oplus,mdss-dsi-manufacture = "NT36672C";
		qcom,dsi-dyn-clk-enable;
		qcom,dsi-dyn-clk-list = <1100051648 1107137888>;
		qcom,mdss-dsi-dma-schedule-line = <120>;
		qcom,mdss-dsi-display-timings {
			timing@0 {
				qcom,mdss-dsi-video-mode;
				qcom,mdss-dsi-panel-width = <1080>;
				qcom,mdss-dsi-panel-height = <2400>;
				qcom,mdss-dsi-h-front-porch = <164>;
				qcom,mdss-dsi-h-back-porch = <62>;
				qcom,mdss-dsi-h-pulse-width = <32>;
				qcom,mdss-dsi-h-sync-skew = <0>;
				qcom,mdss-dsi-v-back-porch = <10>;
				qcom,mdss-dsi-v-front-porch = <54>;
				qcom,mdss-dsi-v-pulse-width = <10>;
				qcom,mdss-dsi-panel-framerate = <120>;
				qcom,mdss-dsi-on-command = [
					15 01 00 00 00 00 02 FF 25
					15 01 00 00 00 00 02 FB 01
					15 01 00 00 00 00 02 18 20

					15 01 00 00 00 00 02 FF 10
					15 01 00 00 00 00 02 FB 01
					39 01 00 00 00 00 11 C1 89 28 00 0C 02 00 02 0E 01 1F 00 07 08 BB 08 7A
					39 01 00 00 00 00 03 C2 10 F0

					15 01 00 00 00 00 02 FF E0
					15 01 00 00 00 00 02 FB 01
					15 01 00 00 00 00 02 35 82

					15 01 00 00 00 00 02 FF 20
					15 01 00 00 00 00 02 FB 01
					15 01 00 00 00 00 02 06 50
					15 01 00 00 00 00 02 6D 55

					15 01 00 00 00 00 02 FF F0
					15 01 00 00 00 00 02 FB 01
					15 01 00 00 00 00 02 1C 01
					15 01 00 00 00 00 02 33 01
					15 01 00 00 00 00 02 5A 00
					15 01 00 00 00 00 02 9C 17

					15 01 00 00 00 00 02 FF D0
					15 01 00 00 00 00 02 FB 01
					15 01 00 00 00 00 02 53 22
					15 01 00 00 00 00 02 54 02

					15 01 00 00 00 00 02 FF C0
					15 01 00 00 00 00 02 FB 01
					15 01 00 00 00 00 02 9C 11
					15 01 00 00 00 00 02 9D 11

					15 01 00 00 00 00 02 FF 23
					15 01 00 00 00 00 02 FB 01
					15 01 00 00 00 00 02 00 80
					15 01 00 00 00 00 02 05 22
					15 01 00 00 00 00 02 06 01
					15 01 00 00 00 00 02 07 00
					15 01 00 00 00 00 02 08 01
					15 01 00 00 00 00 02 09 00
					15 01 00 00 00 00 02 10 82
					15 01 00 00 00 00 02 11 01
					15 01 00 00 00 00 02 12 95
					15 01 00 00 00 00 02 15 68
					15 01 00 00 00 00 02 16 08

					15 01 00 00 00 00 02 30 FF
					15 01 00 00 00 00 02 31 FD
					15 01 00 00 00 00 02 32 FA
					15 01 00 00 00 00 02 33 F7
					15 01 00 00 00 00 02 34 F4
					15 01 00 00 00 00 02 35 F0
					15 01 00 00 00 00 02 36 ED
					15 01 00 00 00 00 02 37 EC
					15 01 00 00 00 00 02 38 EB
					15 01 00 00 00 00 02 39 EA
					15 01 00 00 00 00 02 3A E9
					15 01 00 00 00 00 02 3B E8
					15 01 00 00 00 00 02 3D E7
					15 01 00 00 00 00 02 3F E6
					15 01 00 00 00 00 02 40 E5
					15 01 00 00 00 00 02 41 E4

					15 01 00 00 00 00 02 45 FF
					15 01 00 00 00 00 02 46 FA
					15 01 00 00 00 00 02 47 F2
					15 01 00 00 00 00 02 48 E8
					15 01 00 00 00 00 02 49 E4
					15 01 00 00 00 00 02 4A DC
					15 01 00 00 00 00 02 4B D7
					15 01 00 00 00 00 02 4C D5
					15 01 00 00 00 00 02 4D D3
					15 01 00 00 00 00 02 4E D2
					15 01 00 00 00 00 02 4F D0
					15 01 00 00 00 00 02 50 CE
					15 01 00 00 00 00 02 51 CD
					15 01 00 00 00 00 02 52 CB
					15 01 00 00 00 00 02 53 C6
					15 01 00 00 00 00 02 54 C3

					15 01 00 00 00 00 02 FF 25
					15 01 00 00 00 00 02 FB 01
					15 01 00 00 00 00 02 D7 82
					15 01 00 00 00 00 02 DA 03
					15 01 00 00 00 00 02 DD 02
					15 01 00 00 00 00 02 E0 03

					15 01 00 00 00 00 02 FF 10
					15 01 00 00 00 00 02 FB 01
					39 01 00 00 00 00 06 3B 03 14 36 04 04
					15 01 00 00 00 00 02 B0 00
					15 01 00 00 00 00 02 C0 03
					15 01 00 00 00 00 02 53 2C
					15 01 00 00 00 00 02 35 00
					15 01 00 00 64 00 02 11 00
					15 01 00 00 28 00 02 29 00
				];
				qcom,mdss-dsi-pre-off-command = [
					15 01 00 00 00 00 02 53 24
					39 01 00 00 00 00 03 51 00 00
				];
				qcom,mdss-dsi-off-command = [
					05 01 00 00 14 00 01 28
					05 01 00 00 78 00 01 10
				];
				qcom,mdss-dsi-cabc-ui-command = [
					15 01 00 00 00 00 02 FF 10
					15 01 00 00 00 00 02 FB 01
					15 01 00 00 00 00 02 55 01
				];
				qcom,mdss-dsi-cabc-still-image-command = [
					15 01 00 00 00 00 02 FF 10
					15 01 00 00 00 00 02 FB 01
					15 01 00 00 00 00 02 55 02
				];
				qcom,mdss-dsi-cabc-video-command = [
					15 01 00 00 00 00 02 FF 10
					15 01 00 00 00 00 02 FB 01
					15 01 00 00 00 00 02 55 03
				];
				qcom,mdss-dsi-cabc-off-command = [
					15 01 00 00 00 00 02 FF 10
					15 01 00 00 00 00 02 FB 01
					15 01 00 00 00 00 02 55 00
				];
				qcom,mdss-dsi-backlight-gamma-enter-command = [
					15 00 00 00 00 00 02 FF 10
					15 00 00 00 00 00 02 FB 01
					15 00 00 00 00 00 02 53 24
					15 00 00 00 00 00 02 FF 20
					15 00 00 00 00 00 02 FB 01
					15 00 00 00 00 00 02 95 09
					15 00 00 00 00 00 02 96 09
					39 00 00 00 00 00 11 B0 00 00 00 04 00 0D 00 15 00 1C 00 24 00 2B 00 33
					39 00 00 00 00 00 11 B1 00 39 00 54 00 6B 00 98 00 BF 01 09 01 4E 01 51
					39 00 00 00 00 00 11 B2 01 9B 01 FA 02 36 02 84 02 B9 02 F8 03 0D 03 22
					39 00 00 00 00 00 0F B3 03 39 03 52 03 6F 03 92 03 B6 03 BC 00 00
					39 00 00 00 00 00 11 B4 00 00 00 04 00 0D 00 15 00 1C 00 24 00 2B 00 33
					39 00 00 00 00 00 11 B5 00 39 00 54 00 6B 00 98 00 BF 01 09 01 4E 01 51
					39 00 00 00 00 00 11 B6 01 9B 01 FA 02 36 02 84 02 B9 02 F8 03 0D 03 22
					39 00 00 00 00 00 0F B7 03 39 03 52 03 6F 03 92 03 B6 03 BC 00 00

					39 00 00 00 00 00 11 B8 00 00 00 04 00 0D 00 15 00 1C 00 24 00 2B 00 33
					39 00 00 00 00 00 11 B9 00 39 00 54 00 6B 00 98 00 BF 01 09 01 4E 01 51
					39 00 00 00 00 00 11 BA 01 9B 01 FA 02 36 02 84 02 B9 02 F8 03 0D 03 22
					39 00 00 00 00 00 0F BB 03 39 03 52 03 6F 03 92 03 B6 03 BC 00 00
					15 00 00 00 00 00 02 FF 21
					15 00 00 00 00 00 02 FB 01
					39 00 00 00 00 00 11 B0 00 00 00 04 00 0D 00 15 00 1C 00 24 00 2B 00 33
					39 00 00 00 00 00 11 B1 00 39 00 54 00 6B 00 98 00 BF 01 09 01 4E 01 51
					39 00 00 00 00 00 11 B2 01 9B 01 FA 02 36 02 84 02 B9 02 F8 03 0D 03 22
					39 00 00 00 00 00 0F B3 03 39 03 52 03 6F 03 92 03 B6 03 BC 00 00

					39 00 00 00 00 00 11 B4 00 00 00 04 00 0D 00 15 00 1C 00 24 00 2B 00 33
					39 00 00 00 00 00 11 B5 00 39 00 54 00 6B 00 98 00 BF 01 09 01 4E 01 51
					39 00 00 00 00 00 11 B6 01 9B 01 FA 02 36 02 84 02 B9 02 F8 03 0D 03 22
					39 00 00 00 00 00 0F B7 03 39 03 52 03 6F 03 92 03 B6 03 BC 00 00

					39 00 00 00 00 00 11 B8 00 00 00 04 00 0D 00 15 00 1C 00 24 00 2B 00 33
					39 00 00 00 00 00 11 B9 00 39 00 54 00 6B 00 98 00 BF 01 09 01 4E 01 51
					39 00 00 00 00 00 11 BA 01 9B 01 FA 02 36 02 84 02 B9 02 F8 03 0D 03 22
					39 00 00 00 00 00 0F BB 03 39 03 52 03 6F 03 92 03 B6 03 BC 00 00
					15 00 00 00 00 00 02 FF 10
					15 01 00 00 00 00 02 FB 01
					15 00 00 00 00 00 02 53 2C
				];
				qcom,mdss-dsi-backlight-gamma-exit-command = [
					15 00 00 00 00 00 02 FF 10
					15 00 00 00 00 00 02 FB 01
					15 00 00 00 00 00 02 53 24
					15 00 00 00 00 00 02 FF 20
					15 00 00 00 00 00 02 FB 01
					15 00 00 00 00 00 02 95 D1
					15 00 00 00 00 00 02 96 D1
					39 00 00 00 00 00 11 B0 00 00 00 1C 00 47 00 6A 00 86 00 9E 00 B4 00 C7
					39 00 00 00 00 00 11 B1 00 D8 01 12 01 3A 01 7E 01 AC 01 F8 02 30 02 32
					39 00 00 00 00 00 11 B2 02 68 02 A5 02 CD 02 FE 03 21 03 48 03 57 03 65
					39 00 00 00 00 00 0F B3 03 76 03 89 03 9E 03 AF 03 D1 03 D8 00 00

					39 00 00 00 00 00 11 B4 00 00 00 1C 00 47 00 6A 00 86 00 9E 00 B4 00 C7
					39 00 00 00 00 00 11 B5 00 D8 01 12 01 3A 01 7E 01 AC 01 F8 02 30 02 32
					39 00 00 00 00 00 11 B6 02 68 02 A5 02 CD 02 FE 03 21 03 48 03 57 03 65
					39 00 00 00 00 00 0F B7 03 76 03 89 03 9E 03 AF 03 D1 03 D8 00 00

					39 00 00 00 00 00 11 B8 00 00 00 1C 00 47 00 6A 00 86 00 9E 00 B4 00 C7
					39 00 00 00 00 00 11 B9 00 D8 01 12 01 3A 01 7E 01 AC 01 F8 02 30 02 32
					39 00 00 00 00 00 11 BA 02 68 02 A5 02 CD 02 FE 03 21 03 48 03 57 03 65
					39 00 00 00 00 00 0F BB 03 76 03 89 03 9E 03 AF 03 D1 03 D8 00 00

					15 00 00 00 00 00 02 FF 21
					15 00 00 00 00 00 02 FB 01

					39 00 00 00 00 00 11 B0 00 00 00 1C 00 47 00 6A 00 86 00 9E 00 B4 00 C7
					39 00 00 00 00 00 11 B1 00 D8 01 12 01 3A 01 7E 01 AC 01 F8 02 30 02 32
					39 00 00 00 00 00 11 B2 02 68 02 A5 02 CD 02 FE 03 21 03 48 03 57 03 65
					39 00 00 00 00 00 0F B3 03 76 03 89 03 9E 03 AF 03 D1 03 D8 00 00

					39 00 00 00 00 00 11 B4 00 00 00 1C 00 47 00 6A 00 86 00 9E 00 B4 00 C7
					39 00 00 00 00 00 11 B5 00 D8 01 12 01 3A 01 7E 01 AC 01 F8 02 30 02 32
					39 00 00 00 00 00 11 B6 02 68 02 A5 02 CD 02 FE 03 21 03 48 03 57 03 65
					39 00 00 00 00 00 0F B7 03 76 03 89 03 9E 03 AF 03 D1 03 D8 00 00

					39 00 00 00 00 00 11 B8 00 00 00 1C 00 47 00 6A 00 86 00 9E 00 B4 00 C7
					39 00 00 00 00 00 11 B9 00 D8 01 12 01 3A 01 7E 01 AC 01 F8 02 30 02 32
					39 00 00 00 00 00 11 BA 02 68 02 A5 02 CD 02 FE 03 21 03 48 03 57 03 65
					39 00 00 00 00 00 0F BB 03 76 03 89 03 9E 03 AF 03 D1 03 D8 00 00
					15 00 00 00 00 00 02 FF 10
					15 01 00 00 00 00 02 FB 01
					15 00 00 00 00 00 02 53 2C
				];
				qcom,compression-mode = "dsc";
				qcom,mdss-dsc-slice-height = <12>;
				qcom,mdss-dsc-slice-width = <540>;
				qcom,mdss-dsc-slice-per-pkt = <1>;
				qcom,mdss-dsc-bit-per-component = <8>;
				qcom,mdss-dsc-bit-per-pixel = <8>;
				qcom,mdss-dsc-block-prediction-enable;
				qcom,mdss-dsi-on-command-state = "dsi_lp_mode";
				qcom,mdss-dsi-off-command-state = "dsi_lp_mode";
				qcom,mdss-dsi-cabc-ui-command-state = "dsi_hs_mode";
				qcom,mdss-dsi-cabc-still-image-command-state = "dsi_hs_mode";
				qcom,mdss-dsi-cabc-video-command-state = "dsi_hs_mode";
				qcom,mdss-dsi-cabc-off-command-state = "dsi_hs_mode";
				qcom,mdss-dsi-pre-off-command-state = "dsi_hs_mode";
				qcom,mdss-dsi-backlight-gamma-enter-command-state = "dsi_hs_mode";
				qcom,mdss-dsi-backlight-gamma-exit-command-state = "dsi_hs_mode";
			};
		};
	};
};
&dsi_oplus22821_nt36672c_tianma_fhd_video {
	oplus,mdss-dsi-pre-bl-delay-enabled;
	oplus,mdss-dsi-pre-bl-delay-ms = <30>;
	oplus,mdss-dsi-cabc-enabled;
	oplus,mdss-dsi-lp-config-flag;
	oplus,lcd_switch_enabled;
	oplus,mdss-dsi-gamma-switch-enabled;
	qcom,panel-supply-entries = <&dsi_panel_pwr_supply>;
	qcom,mdss-dsi-bl-pmic-control-type = "bl_ctrl_dcs";
	qcom,bl-pmic-pwm-period-usecs = <100>;
	qcom,bl-update-flag = "delay_until_first_frame";
	qcom,mdss-dsi-bl-min-level = <1>;
	qcom,mdss-dsi-bl-normal-max-level = <3276>;
	qcom,mdss-dsi-bl-max-level = <4095>;
	qcom,mdss-brightness-normal-max-level = <3276>;
	qcom,mdss-brightness-max-level = <4095>;
	qcom,mdss-brightness-default-level = <930>;
	qcom,platform-te-gpio = <&tlmm 23 0>;
	qcom,platform-reset-gpio = <&tlmm 47 0>;
	qcom,platform-tp-cs-gpio = <&tlmm 3 0>;
	qcom,dsi-select-clocks = "mux_byte_clk0", "mux_pixel_clk0",
				"src_byte_clk0", "src_pixel_clk0",
				"shadow_byte_clk0", "shadow_pixel_clk0";
	qcom,esd-check-enabled;
	qcom,mdss-dsi-panel-status-check-mode = "reg_read";
	qcom,mdss-dsi-panel-status-command = [06 01 00 01 00 00 01 0A];
	qcom,mdss-dsi-panel-status-command-state = "dsi_lp_mode";
	qcom,mdss-dsi-panel-status-value = <0x9C>;
	qcom,mdss-dsi-panel-status-read-length = <1>;
	qcom,mdss-dsi-t-clk-post = <0x0F>;
	qcom,mdss-dsi-t-clk-pre = <0x1E>;
	qcom,mdss-dsi-pan-enable-dynamic-fps;
	qcom,mdss-dsi-pan-fps-update = "dfps_immediate_porch_mode_vfp";
	qcom,dsi-supported-dfps-list = <120 90 60 50 48 30>;
	qcom,mdss-dsi-qsync-min-refresh-rate = <30>;
	qcom,mdss-dsi-qsync-max-refresh-rate = <120>;
	oplus,disable-53h-control;
	qcom,mdss-dsi-display-timings {
		timing@0 {
			qcom,mdss-dsi-panel-phy-timings = [00 24 0A 0A 1A 18 0A
				0A 09 02 04 00 1E 0F];
			qcom,display-topology = <1 1 1>;
			qcom,default-topology-index = <0>;
		};
	};
};
