&mdss_mdp {
	dsi_oplus22045_ili7807s_dsjdi_fhd_video: qcom,mdss_dsi_oplus22045_ili7807s_dsjdi_fhd_video {
		qcom,mdss-dsi-panel-name =
			"ili7807s video mode dsi fhd panel";
		qcom,mdss-dsi-panel-type = "dsi_video_mode";

		qcom,dsi-ctrl-num = <0>;
		qcom,dsi-phy-num = <0>;
		qcom,mdss-dsi-virtual-channel-id = <0>;
		qcom,mdss-dsi-stream = <0>;
		qcom,mdss-dsi-bpp = <24>;
		qcom,mdss-dsi-color-order = "rgb_swap_rgb";
		qcom,mdss-dsi-underflow-color = <0xff>;
		qcom,mdss-dsi-border-color = <0>;

		qcom,mdss-dsi-traffic-mode = "burst_mode";
		qcom,mdss-dsi-lane-map = "lane_map_0123";
		qcom,mdss-dsi-bllp-eof-power-mode;
		qcom,mdss-dsi-bllp-power-mode;
		qcom,mdss-dsi-lane-0-state;
		qcom,mdss-dsi-lane-1-state;
		qcom,mdss-dsi-lane-2-state;
		qcom,mdss-dsi-lane-3-state;
		qcom,mdss-dsi-dma-trigger = "trigger_sw";
		qcom,mdss-dsi-mdp-trigger = "none";
		qcom,mdss-dsi-lp11-init;
		qcom,mdss-dsi-bl-pmic-control-type = "bl_ctrl_dcs";
		qcom,mdss-dsi-bl-min-level = <1>;
		qcom,mdss-dsi-bl-normal-max-level = <3276>;
		qcom,mdss-dsi-bl-max-level = <4095>;
		qcom,mdss-brightness-normal-max-level = <3276>;
		qcom,mdss-brightness-max-level = <4095>;
		qcom,mdss-brightness-default-level = <400>;
		qcom,mdss-dsi-reset-sequence = <1 10>, <0 10>, <1 10>;
		qcom,mdss-pan-physical-width-dimension = <70>;
		qcom,mdss-pan-physical-height-dimension = <156>;
		oplus,mdss-dsi-vendor-name = "JDI_ILI7807S";
		oplus,mdss-dsi-manufacture = "dsjm";
		qcom,dsi-dyn-clk-enable;
		qcom,dsi-dyn-clk-list = <1100074176 1107028504>;
		qcom,mdss-dsi-display-timings {
			timing@0 {
				qcom,mdss-dsi-video-mode;
				qcom,mdss-dsi-panel-width = <1080>;
				qcom,mdss-dsi-panel-height = <2400>;
				qcom,mdss-dsi-h-front-porch = <120>;
				qcom,mdss-dsi-h-back-porch = <130>;
				qcom,mdss-dsi-h-pulse-width = <4>;
				qcom,mdss-dsi-h-sync-skew = <0>;
				qcom,mdss-dsi-v-back-porch = <47>;
				qcom,mdss-dsi-v-front-porch = <40>;
				qcom,mdss-dsi-v-pulse-width = <4>;
				qcom,mdss-dsi-panel-framerate = <120>;
				qcom,mdss-dsi-on-command = [
					39 01 00 00 00 00 04 FF 78 07 06
					15 01 00 00 00 00 02 3E E2
					15 01 00 00 00 00 02 48 0F
					15 01 00 00 00 00 02 4D FF
					15 01 00 00 00 00 02 4E FF
					15 01 00 00 00 00 02 4F 23
					15 01 00 00 00 00 02 C7 05

					/* Digtial SSC Setting */
					39 01 00 00 00 00 04 FF 78 07 0B
					15 01 00 00 00 00 02 E7 4B
					15 01 00 00 00 00 02 E8 03

					39 01 00 00 00 00 04 FF 78 07 02
					15 01 00 00 00 00 02 1B 02               //frame 120/240
					39 01 00 00 00 00 04 FF 78 07 04
					15 01 00 00 00 00 02 BD 01
					39 01 00 00 00 00 04 FF 78 07 07
					15 01 00 00 00 00 02 29 CF

					39 01 00 00 00 00 04 FF 78 07 06
					15 01 00 00 00 00 02 08 20
					39 01 00 00 00 00 04 FF 78 07 03
					15 01 00 00 00 00 02 83 20
					15 01 00 00 00 00 02 84 01

					39 01 00 00 00 00 04 FF 78 07 03
					15 01 00 00 00 00 02 86 47
					15 01 00 00 00 00 02 87 56
					15 01 00 00 00 00 02 AF 18
					15 01 00 00 00 00 02 8C E2
					15 01 00 00 00 00 02 8D E3
					15 01 00 00 00 00 02 8E E5
					15 01 00 00 00 00 02 8F E6
					15 01 00 00 00 00 02 90 E9
					15 01 00 00 00 00 02 91 EB
					15 01 00 00 00 00 02 92 EE
					15 01 00 00 00 00 02 93 F0
					15 01 00 00 00 00 02 94 F6
					15 01 00 00 00 00 02 95 FA

					15 01 00 00 00 00 02 96 BF
					15 01 00 00 00 00 02 97 C4
					15 01 00 00 00 00 02 98 C7
					15 01 00 00 00 00 02 99 C9
					15 01 00 00 00 00 02 9A CF
					15 01 00 00 00 00 02 9B D4
					15 01 00 00 00 00 02 9C DA
					15 01 00 00 00 00 02 9D E2
					15 01 00 00 00 00 02 9E EB
					15 01 00 00 00 00 02 9F FA

					39 01 00 00 00 00 04 FF 78 07 0B
					15 01 00 00 00 00 02 94 84
					15 01 00 00 00 00 02 95 10
					15 01 00 00 00 00 02 96 03
					15 01 00 00 00 00 02 97 03
					15 01 00 00 00 00 02 98 65
					15 01 00 00 00 00 02 99 65
					15 01 00 00 00 00 02 9A 41
					15 01 00 00 00 00 02 9B AB
					15 01 00 00 00 00 02 9C 02
					15 01 00 00 00 00 02 9D 02
					15 01 00 00 00 00 02 9E 2A
					15 01 00 00 00 00 02 9F 2A

					39 01 00 00 00 00 04 FF 78 07 0E
					15 01 00 00 00 00 02 05 20
					39 01 00 00 00 00 04 FF 78 07 0C
					15 01 00 00 00 00 02 80 3F
					15 01 00 00 00 00 02 81 E8
					15 01 00 00 00 00 02 82 3F
					15 01 00 00 00 00 02 83 E8

					39 01 00 00 00 00 04 FF 78 07 0E
					15 01 00 00 00 00 02 45 11
					15 01 00 00 00 00 02 46 29
					15 01 00 00 00 00 02 47 20
					15 01 00 00 00 00 02 49 58
					15 01 00 00 00 00 02 B0 00
					15 01 00 00 00 00 02 B1 2E
					15 01 00 00 00 00 02 C0 02
					15 01 00 00 00 00 02 C2 2E
					15 01 00 00 00 00 02 C3 2E
					15 01 00 00 00 00 02 C4 2E
					15 01 00 00 00 00 02 C5 2E
					15 01 00 00 00 00 02 C6 2E
					15 01 00 00 00 00 02 C7 2E
					15 01 00 00 00 00 02 C8 2E
					15 01 00 00 00 00 02 C9 2E
					15 01 00 00 00 00 02 4D 5B

					39 01 00 00 00 00 04 FF 78 07 00
					15 01 00 00 00 00 02 53 24
					15 01 00 00 00 00 02 55 00
					15 01 00 00 00 00 02 35 00
					39 01 00 00 00 00 04 FF 78 07 00
					05 01 00 00 60 00 01 11
					05 01 00 00 14 00 01 29
				];

				qcom,mdss-dsi-post-on-backlight = [
					39 01 00 00 00 00 04 FF 78 07 06
					15 01 00 00 00 00 02 3C 08
					39 01 00 00 00 00 04 FF 78 07 00
				];
				qcom,mdss-dsi-pre-off-command = [
				];
				qcom,mdss-dsi-off-command = [
					39 01 00 00 00 00 04 FF 78 07 00
					05 01 00 00 14 00 01 28
					05 01 00 00 78 00 01 10
				];
				qcom,mdss-dsi-cabc-ui-command = [
					39 01 00 00 00 00 04 FF 78 07 00
					15 01 00 00 00 00 02 53 2C
					15 01 00 00 00 00 02 55 01
				];
				qcom,mdss-dsi-cabc-still-image-command = [
					39 01 00 00 00 00 04 FF 78 07 00
					15 01 00 00 00 00 02 53 2C
					15 01 00 00 00 00 02 55 02
				];
				qcom,mdss-dsi-cabc-video-command = [
					39 01 00 00 00 00 04 FF 78 07 00
					15 01 00 00 00 00 02 53 2C
					15 01 00 00 00 00 02 55 03
				];
				qcom,mdss-dsi-cabc-off-command = [
					39 01 00 00 00 00 04 FF 78 07 00
					15 01 00 00 00 00 02 53 2C
					15 01 00 00 00 00 02 55 00
				];
				qcom,mdss-dsi-backlight-gamma-enter-command = [
					39 00 00 00 00 00 04 FF 78 07 08
					39 00 00 00 00 00 20 E0 15 B9 BB BE 15 C5 CC D2 15 DF EA FF 2A 13 3C 63 2A 90 C7 EC 3F 1C 3D 61 3F 7B 98 C1 0F D8 D9
					39 00 00 00 00 00 20 E1 15 B9 BB BE 15 C5 CC D2 15 DF EA FF 2A 13 3C 63 2A 90 C7 EC 3F 1C 3D 61 3F 7B 98 C1 0F D8 D9
					39 01 00 00 00 00 04 FF 78 07 00
				];
				qcom,mdss-dsi-backlight-gamma-exit-command = [
					39 00 00 00 00 00 04 FF 78 07 08
					39 00 00 00 00 00 20 E0 00 00 20 4F 00 8F BB DE 15 13 3B 78 25 A7 EC 23 2A 58 93 B9 3E E9 09 39 3F 4F 70 A4 0F CD D9
					39 00 00 00 00 00 20 E1 00 00 20 4F 00 8F BB DE 15 13 3B 78 25 A7 EC 23 2A 58 93 B9 3E E9 09 39 3F 4F 70 A4 0F CD D9
					39 01 00 00 00 00 04 FF 78 07 00
				];
				qcom,compression-mode = "dsc";
				qcom,mdss-dsc-slice-height = <12>;
				qcom,mdss-dsc-slice-width = <540>;
				qcom,mdss-dsc-slice-per-pkt = <2>;
				qcom,mdss-dsc-bit-per-component = <8>;
				qcom,mdss-dsc-bit-per-pixel = <8>;
				qcom,mdss-dsc-block-prediction-enable;
				qcom,mdss-dsi-on-command-state = "dsi_lp_mode";
				qcom,mdss-dsi-off-command-state = "dsi_lp_mode";
				qcom,mdss-dsi-cabc-ui-command-state = "dsi_lp_mode";
				qcom,mdss-dsi-cabc-still-image-command-state = "dsi_lp_mode";
				qcom,mdss-dsi-cabc-video-command-state = "dsi_lp_mode";
				qcom,mdss-dsi-cabc-off-command-state = "dsi_lp_mode";
				qcom,mdss-dsi-pre-off-command-state = "dsi_lp_mode";
				qcom,mdss-dsi-backlight-gamma-enter-command-state = "dsi_lp_mode";
				qcom,mdss-dsi-backlight-gamma-exit-command-state = "dsi_lp_mode";
			};
		};
	};
};
&dsi_oplus22045_ili7807s_dsjdi_fhd_video {
	oplus,mdss-dsi-pre-bl-delay-enabled;
	oplus,mdss-dsi-pre-bl-delay-ms = <30>;
	oplus,mdss-dsi-cabc-enabled;
	oplus,mdss-dsi-lp-config-flag;
	oplus,lcd_switch_enabled;
	oplus,mdss-dsi-gamma-switch-enabled;
	qcom,panel-supply-entries = <&dsi_panel_pwr_supply>;
	qcom,mdss-dsi-bl-pmic-control-type = "bl_ctrl_dcs";
	qcom,bl-pmic-pwm-period-usecs = <100>;
	qcom,bl-update-flag = "delay_until_first_frame";
	qcom,mdss-dsi-bl-min-level = <1>;
	qcom,mdss-dsi-bl-normal-max-level = <3276>;
	qcom,mdss-dsi-bl-max-level = <4095>;
	qcom,mdss-brightness-normal-max-level = <3276>;
	qcom,mdss-brightness-max-level = <4095>;
	qcom,mdss-brightness-default-level = <930>;
	qcom,platform-te-gpio = <&tlmm 23 0>;
	qcom,platform-reset-gpio = <&tlmm 47 0>;
	qcom,dsi-select-clocks = "mux_byte_clk0", "mux_pixel_clk0",
				"src_byte_clk0", "src_pixel_clk0",
				"shadow_byte_clk0", "shadow_pixel_clk0";
	qcom,esd-check-enabled;
	qcom,mdss-dsi-panel-status-check-mode = "reg_read";
	qcom,mdss-dsi-panel-status-command = [06 01 00 01 00 00 01 0A
						06 01 00 01 00 00 01 0D];
	qcom,mdss-dsi-panel-status-command-state = "dsi_lp_mode";
	qcom,mdss-dsi-panel-status-value = <0x9C 0x00>;
	qcom,mdss-dsi-panel-status-read-length = <1 1>;
	qcom,mdss-dsi-t-clk-post = <0x0F>;
	qcom,mdss-dsi-t-clk-pre = <0x1E>;
	qcom,mdss-dsi-pan-enable-dynamic-fps;
	qcom,mdss-dsi-pan-fps-update = "dfps_immediate_porch_mode_vfp";
	qcom,dsi-supported-dfps-list = <120 90 60 50 48 30>;
	qcom,mdss-dsi-qsync-min-refresh-rate = <30>;
	qcom,mdss-dsi-qsync-max-refresh-rate = <120>;
	oplus,disable-53h-control;
	qcom,mdss-dsi-display-timings {
		timing@0 {
			qcom,mdss-dsi-panel-phy-timings = [00 24 0A 0A 1A 18 0A
				0A 09 02 04 00 1E 0F];
			qcom,display-topology = <1 1 1>;
			qcom,default-topology-index = <0>;
		};
	};
};
