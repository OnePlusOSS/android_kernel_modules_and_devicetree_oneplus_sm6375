&mdss_mdp {
	dsi_nt36523_boe_video: qcom,mdss_dsi_nt36523_boe_video {
		qcom,mdss-dsi-panel-name = "djnt nt36523a 21653 fhdp mipi panel";
		oplus,mdss-dsi-manufacture = "djnt";
		oplus,mdss-dsi-vendor-name = "NT36523A";

		qcom,mdss-dsi-panel-type = "dsi_video_mode";
		qcom,bl-update-flag = "delay_until_first_frame";
		qcom,dsi-ctrl-num = <0>;
		qcom,dsi-phy-num = <0>;
		// qcom,mdss-dsi-panel-orientation = "180";
		qcom,mdss-dsi-virtual-channel-id = <0>;
		qcom,mdss-dsi-stream = <0>;
		qcom,mdss-dsi-h-left-border = <0>;
		qcom,mdss-dsi-h-right-border = <0>;
		qcom,mdss-dsi-v-top-border = <0>;
		qcom,mdss-dsi-v-bottom-border = <0>;
		qcom,mdss-dsi-bpp = <24>;
		qcom,mdss-dsi-color-order = "rgb_swap_rgb";
		qcom,mdss-dsi-underflow-color = <0xff>;
		qcom,mdss-dsi-border-color = <0>;
		qcom,mdss-dsi-h-sync-pulse = <0>;
		qcom,mdss-dsi-traffic-mode = "burst_mode";
		qcom,mdss-dsi-lane-map = "lane_map_0123";
		qcom,mdss-dsi-bllp-eof-power-mode;
		qcom,mdss-dsi-bllp-power-mode;
		qcom,mdss-dsi-tx-eot-append;
		qcom,mdss-dsi-lane-0-state;
		qcom,mdss-dsi-lane-1-state;
		qcom,mdss-dsi-lane-2-state;
		qcom,mdss-dsi-lane-3-state;
		qcom,mdss-dsi-dma-trigger = "trigger_sw";
		qcom,mdss-dsi-mdp-trigger = "none";
		qcom,mdss-dsi-lp11-init;
		qcom,mdss-dsi-reset-sequence = <0 10>, <1 10>, <0 10>, <1 10>;
		qcom,mdss-pan-physical-width-dimension = <143>;
		qcom,mdss-pan-physical-height-dimension = <239>;
		qcom,platform-reset-gpio-always-on;
		qcom,mdss-dsi-display-timings {
			timing@0 {
				qcom,mdss-dsi-panel-width = <1200>;
				qcom,mdss-dsi-panel-height = <2000>;
				qcom,mdss-dsi-h-front-porch = <34>;
				qcom,mdss-dsi-h-back-porch = <32>;
				qcom,mdss-dsi-h-pulse-width = <1>;
				qcom,mdss-dsi-h-sync-skew = <0>;
				qcom,mdss-dsi-h-sync-pulse = <0>;
				qcom,mdss-dsi-v-back-porch = <148>;
				qcom,mdss-dsi-v-front-porch = <26>;
				qcom,mdss-dsi-v-pulse-width = <2>;
				qcom,mdss-dsi-panel-framerate = <60>;
				qcom,mdss-dsi-on-command =[
					15 01 00 00 00 00 02 FF 20
					15 01 00 00 00 00 02 FB 01
					15 01 00 00 00 00 02 05 D9
					//VGH=17V
					15 01 00 00 00 00 02 07 78
					//VGL=-14V
					15 01 00 00 00 00 02 08 5A
					//EN_VMODGATE2=1
					15 01 00 00 00 00 02 0D 63
					//VGH=16V
					15 01 00 00 00 00 02 0E 91
					//VGL=-13V
					15 01 00 00 00 00 02 0F 73
					//VCOM=-0.9V
					//REGW  89 79
					//REGW  8A 79
					//REGW  8B 79
					//REGW  8C 79
					//GVDD=5.2V
					15 01 00 00 00 00 02 95 E6
					15 01 00 00 00 00 02 96 F0

					//20211223 C03
					//Disable LV Detect
					15 01 00 00 00 00 02 30 00

					//ISOP
					15 01 00 00 00 00 02 6D 66

					//EN_GMACP
					15 01 00 00 00 00 02 75 A2

					//V128
					15 01 00 00 00 00 02 77 3B

					//R(+)
					39 01 00 00 00 00 11 B0 00 08 00 23 00 4D 00 6D 00 89 00 A1 00 B6 00 C9
					39 01 00 00 00 00 11 B1 00 DA 01 13 01 3C 01 7E 01 AB 01 F7 02 2F 02 31
					39 01 00 00 00 00 11 B2 02 67 02 A6 02 D1 03 08 03 2E 03 5B 03 6B 03 7B
					39 01 00 00 00 00 0D B3 03 8E 03 A2 03 B7 03 E7 03 FD 03 FF
					//G(+)
					39 01 00 00 00 00 11 B4 00 08 00 23 00 4D 00 6D 00 89 00 A1 00 B6 00 C9
					39 01 00 00 00 00 11 B5 00 DA 01 13 01 3C 01 7E 01 AB 01 F7 02 2F 02 31
					39 01 00 00 00 00 11 B6 02 67 02 A6 02 D1 03 08 03 2E 03 5B 03 6B 03 7B
					39 01 00 00 00 00 0D B7 03 8E 03 A2 03 B7 03 E7 03 FD 03 FF
					//B(+)
					39 01 00 00 00 00 11 B8 00 08 00 23 00 4D 00 6D 00 89 00 A1 00 B6 00 C9
					39 01 00 00 00 00 11 B9 00 DA 01 13 01 3C 01 7E 01 AB 01 F7 02 2F 02 31
					39 01 00 00 00 00 11 BA 02 67 02 A6 02 D1 03 08 03 2E 03 5B 03 6B 03 7B
					39 01 00 00 00 00 0D BB 03 8E 03 A2 03 B7 03 E7 03 FD 03 FF
					/* CABC Gamma Offset Setting */
					39 01 00 00 00 00 0D C3 27 26 1E 20 19 18 17 16 15 13 07 03
					//CMD2_Page1
					15 01 00 00 00 00 02 FF 21
					15 01 00 00 00 00 02 FB 01
					//R(-)
					39 01 00 00 00 00 11 B0 00 00 00 1B 00 45 00 65 00 81 00 99 00 AE 00 C1
					39 01 00 00 00 00 11 B1 00 D2 01 0B 01 34 01 76 01 A3 01 EF 02 27 02 29
					39 01 00 00 00 00 11 B2 02 5F 02 9E 02 C9 03 00 03 26 03 53 03 63 03 73
					39 01 00 00 00 00 0D B3 03 86 03 9A 03 AF 03 DF 03 F5 03 E0
					//G(-)
					39 01 00 00 00 00 11 B4 00 00 00 1B 00 45 00 65 00 81 00 99 00 AE 00 C1
					39 01 00 00 00 00 11 B5 00 D2 01 0B 01 34 01 76 01 A3 01 EF 02 27 02 29
					39 01 00 00 00 00 11 B6 02 5F 02 9E 02 C9 03 00 03 26 03 53 03 63 03 73
					39 01 00 00 00 00 0D B7 03 86 03 9A 03 AF 03 DF 03 F5 03 E0
					//B(-)
					39 01 00 00 00 00 11 B8 00 00 00 1B 00 45 00 65 00 81 00 99 00 AE 00 C1
					39 01 00 00 00 00 11 B9 00 D2 01 0B 01 34 01 76 01 A3 01 EF 02 27 02 29
					39 01 00 00 00 00 11 BA 02 5F 02 9E 02 C9 03 00 03 26 03 53 03 63 03 73
					39 01 00 00 00 00 0D BB 03 86 03 9A 03 AF 03 DF 03 F5 03 E0

					/* CABC Setting */
					15 01 00 00 00 00 02 FF 23
					15 01 00 00 00 00 02 FB 01
					/* APL_WT */
					15 01 00 00 00 00 02 10 0C
					/* APL_THD */
					15 01 00 00 00 00 02 11 01
					15 01 00 00 00 00 02 12 77
					/* APL_COMP */
					15 01 00 00 00 00 02 15 07
					15 01 00 00 00 00 02 16 07
					/* CABC_PWM_UI */
					15 01 00 00 00 00 02 30 FF
					15 01 00 00 00 00 02 31 FC
					15 01 00 00 00 00 02 32 FA
					15 01 00 00 00 00 02 33 F4
					15 01 00 00 00 00 02 34 F2
					15 01 00 00 00 00 02 35 F0
					15 01 00 00 00 00 02 36 EF
					15 01 00 00 00 00 02 37 EC
					15 01 00 00 00 00 02 38 EC
					15 01 00 00 00 00 02 39 E9
					15 01 00 00 00 00 02 3A E9
					15 01 00 00 00 00 02 3B E8
					15 01 00 00 00 00 02 3D E7
					15 01 00 00 00 00 02 3F E6
					15 01 00 00 00 00 02 40 E5
					15 01 00 00 00 00 02 41 E3
					/* CABC_PWM_still */
					15 01 00 00 00 00 02 45 FF
					15 01 00 00 00 00 02 46 FC
					15 01 00 00 00 00 02 47 F4
					15 01 00 00 00 00 02 48 F0
					15 01 00 00 00 00 02 49 ED
					15 01 00 00 00 00 02 4A E8
					15 01 00 00 00 00 02 4B E4
					15 01 00 00 00 00 02 4C E2
					15 01 00 00 00 00 02 4D E0
					15 01 00 00 00 00 02 4E DD
					15 01 00 00 00 00 02 4F DA
					15 01 00 00 00 00 02 50 D8
					15 01 00 00 00 00 02 51 D4
					15 01 00 00 00 00 02 52 D0
					15 01 00 00 00 00 02 53 CE
					15 01 00 00 00 00 02 54 CA
					/* CABC_PWM_MOV */
					15 01 00 00 00 00 02 58 FF
					15 01 00 00 00 00 02 59 FB
					15 01 00 00 00 00 02 5A EE
					15 01 00 00 00 00 02 5B E8
					15 01 00 00 00 00 02 5C E3
					15 01 00 00 00 00 02 5D DE
					15 01 00 00 00 00 02 5E D6
					15 01 00 00 00 00 02 5F D4
					15 01 00 00 00 00 02 60 D2
					15 01 00 00 00 00 02 61 D0
					15 01 00 00 00 00 02 62 CC
					15 01 00 00 00 00 02 63 CC
					15 01 00 00 00 00 02 64 CA
					15 01 00 00 00 00 02 65 C8
					15 01 00 00 00 00 02 66 C4
					15 01 00 00 00 00 02 67 C0

					15 01 00 00 00 00 02 FF 24
					15 01 00 00 00 00 02 FB 01

					//VGL
					15 01 00 00 00 00 02 00 00
					15 01 00 00 00 00 02 01 00
					//VDDO
					15 01 00 00 00 00 02 02 1C
					15 01 00 00 00 00 02 03 1C
					//VDDE
					15 01 00 00 00 00 02 04 1D
					15 01 00 00 00 00 02 05 1D
					//STV0
					15 01 00 00 00 00 02 06 04
					15 01 00 00 00 00 02 07 04
					//CLK8
					15 01 00 00 00 00 02 08 0F
					15 01 00 00 00 00 02 09 0F
					//CLK6
					15 01 00 00 00 00 02 0A 0E
					15 01 00 00 00 00 02 0B 0E
					//CLK4
					15 01 00 00 00 00 02 0C 0D
					15 01 00 00 00 00 02 0D 0D
					//CLK2
					15 01 00 00 00 00 02 0E 0C
					15 01 00 00 00 00 02 0F 0C
					//STV2
					15 01 00 00 00 00 02 10 08
					15 01 00 00 00 00 02 11 08

					15 01 00 00 00 00 02 12 00
					15 01 00 00 00 00 02 13 00
					15 01 00 00 00 00 02 14 00
					15 01 00 00 00 00 02 15 00

					//VGL
					15 01 00 00 00 00 02 16 00
					15 01 00 00 00 00 02 17 00
					//VDDO
					15 01 00 00 00 00 02 18 1C
					15 01 00 00 00 00 02 19 1C
					//VDDE
					15 01 00 00 00 00 02 1A 1D
					15 01 00 00 00 00 02 1B 1D
					//STV0
					15 01 00 00 00 00 02 1C 04
					15 01 00 00 00 00 02 1D 04
					//CLK7
					15 01 00 00 00 00 02 1E 0F
					15 01 00 00 00 00 02 1F 0F
					//CLK5
					15 01 00 00 00 00 02 20 0E
					15 01 00 00 00 00 02 21 0E
					//CLK3
					15 01 00 00 00 00 02 22 0D
					15 01 00 00 00 00 02 23 0D
					//CLK1
					15 01 00 00 00 00 02 24 0C
					15 01 00 00 00 00 02 25 0C
					//STV1
					15 01 00 00 00 00 02 26 08
					15 01 00 00 00 00 02 27 08

					15 01 00 00 00 00 02 28 00
					15 01 00 00 00 00 02 29 00
					15 01 00 00 00 00 02 2A 00
					15 01 00 00 00 00 02 2B 00

					//STV0
					15 01 00 00 00 00 02 2D 20
					15 01 00 00 00 00 02 2F 0A
					15 01 00 00 00 00 02 30 44
					15 01 00 00 00 00 02 33 0C
					15 01 00 00 00 00 02 34 32

					15 01 00 00 00 00 02 37 44
					15 01 00 00 00 00 02 38 40
					15 01 00 00 00 00 02 39 00
					15 01 00 00 00 00 02 3A 5D
					15 01 00 00 00 00 02 3B 60
					15 01 00 00 00 00 02 3D 42

					//STV
					15 01 00 00 00 00 02 3F 06
					15 01 00 00 00 00 02 43 06

					15 01 00 00 00 00 02 47 66
					15 01 00 00 00 00 02 4A 5D
					15 01 00 00 00 00 02 4B 60
					15 01 00 00 00 00 02 4C 91

					//GCK
					15 01 00 00 00 00 02 4D 21
					15 01 00 00 00 00 02 4E 43
					15 01 00 00 00 00 02 51 12
					15 01 00 00 00 00 02 52 34
					39 01 00 00 00 00 03 55 82 02
					15 01 00 00 00 00 02 56 04
					15 01 00 00 00 00 02 58 21
					15 01 00 00 00 00 02 59 30
					15 01 00 00 00 00 02 5A 60
					15 01 00 00 00 00 02 5B 50
					39 01 00 00 00 00 03 5E 00 06
					15 01 00 00 00 00 02 5F 00

					//EN_LFD_SOURCE=0
					15 01 00 00 00 00 02 65 82

					//VDDO, VDDE
					15 01 00 00 00 00 02 7E 20
					15 01 00 00 00 00 02 7F 3C
					15 01 00 00 00 00 02 82 04
					15 01 00 00 00 00 02 97 C0

					39 01 00 00 00 00 0D B6 05 00 05 00 00 00 00 00 05 05 00 00

					//qclk=96/5 Mhz
					15 01 00 00 00 00 02 91 44
					15 01 00 00 00 00 02 92 A9
					15 01 00 00 00 00 02 93 1A
					15 01 00 00 00 00 02 94 96

					//SOG_HBP
					15 01 00 00 00 00 02 D7 55
					15 01 00 00 00 00 02 DA 0A
					15 01 00 00 00 00 02 DE 08

					//Normal
					15 01 00 00 00 00 02 DB 05
					15 01 00 00 00 00 02 DC A9
					15 01 00 00 00 00 02 DD 22
					//Line N
					15 01 00 00 00 00 02 DF 05
					15 01 00 00 00 00 02 E0 A9
					//Line N+1
					15 01 00 00 00 00 02 E1 05
					15 01 00 00 00 00 02 E2 A9
					//TP0
					15 01 00 00 00 00 02 E3 05
					15 01 00 00 00 00 02 E4 A9
					//TP3
					15 01 00 00 00 00 02 E5 05
					15 01 00 00 00 00 02 E6 A9

					//Gate EQ
					//Normal
					15 01 00 00 00 00 02 5C 00
					15 01 00 00 00 00 02 5D 00
					//TP3
					15 01 00 00 00 00 02 8D 00
					15 01 00 00 00 00 02 8E 00

					//No Sync @ TP
					15 01 00 00 00 00 02 B5 90

					15 01 00 00 00 00 02 FF 25
					15 01 00 00 00 00 02 FB 01

					//disable auto_vbp_vfp
					15 01 00 00 00 00 02 05 00

					//ESD_DET_ERR_SEL
					15 01 00 00 00 00 02 19 07

					//DP_N_GCK
					15 01 00 00 00 00 02 1F 60
					15 01 00 00 00 00 02 20 50

					//DP_N_1_GCK
					15 01 00 00 00 00 02 26 60
					15 01 00 00 00 00 02 27 50

					//TP0_GCK
					15 01 00 00 00 00 02 33 60
					15 01 00 00 00 00 02 34 50

					//TP3 GCK/MUX=1
					15 01 00 00 00 00 02 3F E0

					//TP3_GCK_START_LINE
					15 01 00 00 00 00 02 40 00

					//TP3_STV
					15 01 00 00 00 00 02 44 00
					15 01 00 00 00 00 02 45 40

					//TP3_GCK
					15 01 00 00 00 00 02 48 60
					15 01 00 00 00 00 02 49 50

					//LSTP0
					15 01 00 00 00 00 02 5B 00
					15 01 00 00 00 00 02 5C 00
					15 01 00 00 00 00 02 5D 00
					15 01 00 00 00 00 02 5E D0

					15 01 00 00 00 00 02 61 60
					15 01 00 00 00 00 02 62 50

					//en_vfp_addvsync
					15 01 00 00 00 00 02 F1 10


					//CMD2,Page10
					15 01 00 00 00 00 02 FF 2A
					15 01 00 00 00 00 02 FB 01

					//PWRONOFF
					//STV
					15 01 00 00 00 00 02 64 16
					//CLR
					15 01 00 00 00 00 02 67 16
					//GCK
					15 01 00 00 00 00 02 6A 16
					//POL
					15 01 00 00 00 00 02 70 30

					//ABOFF
					15 01 00 00 00 00 02 A2 F3
					15 01 00 00 00 00 02 A3 FF
					15 01 00 00 00 00 02 A4 FF
					15 01 00 00 00 00 02 A5 FF

					//Long_V_TIMING disable
					15 01 00 00 00 00 02 D6 08

					//CMD2,Page6
					15 01 00 00 00 00 02 FF 26
					15 01 00 00 00 00 02 FB 01
					//TPEN
					15 01 00 00 00 00 02 00 A1

					//Table A (60Hz,86*1+87*22=2000)
					15 01 00 00 00 00 02 02 31
					15 01 00 00 00 00 02 04 28
					15 01 00 00 00 00 02 06 30
					//REGW 0A F5
					15 01 00 00 00 00 02 0C 16
					15 01 00 00 00 00 02 0D 0D
					15 01 00 00 00 00 02 0F 00
					15 01 00 00 00 00 02 11 00
					15 01 00 00 00 00 02 12 50
					15 01 00 00 00 00 02 13 56
					15 01 00 00 00 00 02 14 57
					15 01 00 00 00 00 02 15 00
					15 01 00 00 00 00 02 16 10
					15 01 00 00 00 00 02 17 A0
					15 01 00 00 00 00 02 18 86
					15 01 00 00 00 00 02 19 0D
					15 01 00 00 00 00 02 1A 7F
					15 01 00 00 00 00 02 1B 0C
					15 01 00 00 00 00 02 1C BF
					15 01 00 00 00 00 02 22 00
					15 01 00 00 00 00 02 23 00
					15 01 00 00 00 00 02 2A 0D
					15 01 00 00 00 00 02 2B 7F

					15 01 00 00 00 00 02 1D 00
					15 01 00 00 00 00 02 1E 65
					15 01 00 00 00 00 02 1F 65
					15 01 00 00 00 00 02 24 00
					15 01 00 00 00 00 02 25 65
					15 01 00 00 00 00 02 2F 05
					15 01 00 00 00 00 02 30 65
					15 01 00 00 00 00 02 31 05
					15 01 00 00 00 00 02 32 7D
					15 01 00 00 00 00 02 39 00
					15 01 00 00 00 00 02 3A 65

					//PRZ1
					15 01 00 00 00 00 02 20 01

					//PRZ3
					//Rescan=3
					15 01 00 00 00 00 02 33 11
					15 01 00 00 00 00 02 34 78
					15 01 00 00 00 00 02 35 16

					//DLH30Ве (off line shift)
					15 01 00 00 00 00 02 C8 04
					15 01 00 00 00 00 02 C9 9E
					15 01 00 00 00 00 02 CA 4E
					15 01 00 00 00 00 02 CB 00

					15 01 00 00 00 00 02 A9 49
					15 01 00 00 00 00 02 AA 4B
					15 01 00 00 00 00 02 AB 48
					15 01 00 00 00 00 02 AC 43
					15 01 00 00 00 00 02 AD 40
					15 01 00 00 00 00 02 AE 50
					15 01 00 00 00 00 02 AF 44
					15 01 00 00 00 00 02 B0 54
					15 01 00 00 00 00 02 B1 4E
					15 01 00 00 00 00 02 B2 4D
					15 01 00 00 00 00 02 B3 4C
					15 01 00 00 00 00 02 B4 41
					15 01 00 00 00 00 02 B5 47
					15 01 00 00 00 00 02 B6 53
					15 01 00 00 00 00 02 B7 3E
					15 01 00 00 00 00 02 B8 51
					15 01 00 00 00 00 02 B9 3C
					15 01 00 00 00 00 02 BA 3B
					15 01 00 00 00 00 02 BB 46
					15 01 00 00 00 00 02 BC 45
					15 01 00 00 00 00 02 BD 55
					15 01 00 00 00 00 02 BE 3D
					15 01 00 00 00 00 02 BF 3F
					15 01 00 00 00 00 02 C0 52
					15 01 00 00 00 00 02 C1 4A
					15 01 00 00 00 00 02 C2 39
					15 01 00 00 00 00 02 C3 4F
					15 01 00 00 00 00 02 C4 3A
					15 01 00 00 00 00 02 C5 42

					//CMD2,Page7
					15 01 00 00 00 00 02 FF 27
					15 01 00 00 00 00 02 FB 01

					//VPOR_DYNH_EN=1, VPOR_CNT_REV=1
					15 01 00 00 00 00 02 56 06

					//FR0
					15 01 00 00 00 00 02 58 80
					15 01 00 00 00 00 02 59 75
					15 01 00 00 00 00 02 5A 00
					15 01 00 00 00 00 02 5B 02
					15 01 00 00 00 00 02 5C 00
					15 01 00 00 00 00 02 5D 00
					15 01 00 00 00 00 02 5E 20
					15 01 00 00 00 00 02 5F 10
					15 01 00 00 00 00 02 60 00
					15 01 00 00 00 00 02 61 2E
					15 01 00 00 00 00 02 62 00
					15 01 00 00 00 00 02 63 01
					15 01 00 00 00 00 02 64 43
					15 01 00 00 00 00 02 65 2D
					15 01 00 00 00 00 02 66 00
					15 01 00 00 00 00 02 67 01
					15 01 00 00 00 00 02 68 44

					15 01 00 00 00 00 02 00 00
					15 01 00 00 00 00 02 78 00
					15 01 00 00 00 00 02 C3 00

					//Default
					//REGW D1 24
					//REGW D2 30

					//FTE output TE, FTE1 output TSVD, LEDPWM output TSHD
					//REGW D1 44
					//REGW D2 57

					//FTE output TE, FTE1 output TSVD, LEDPWM output TSHD_NVT
					//REGW D1 24
					//REGW D2 63

					//FTE output TE, FTE1 output TSHD, LEDPWM output TSHD_NVT
					//REGW D1 25
					//REGW D2 63

					//FTE output TE, FTE1 output Internal H
					//REGW D1 29
					//REGW D2 00

					//FTE output TE, FTE1 output TSVD, LEDPWM output UL_Valid
					//REGW D1 24
					//REGW D2 D3
					//REGW D3 04

					//CMD2,Page10
					15 01 00 00 00 00 02 FF 2A
					15 01 00 00 00 00 02 FB 01

					//PEN_EN=1, UL_FREQ=0
					15 01 00 00 00 00 02 22 2F
					15 01 00 00 00 00 02 23 08

					//FR0 (60Hz, IVE4 VFP=26)
					15 01 00 00 00 00 02 24 00
					15 01 00 00 00 00 02 25 65
					15 01 00 00 00 00 02 26 F8
					15 01 00 00 00 00 02 27 00
					15 01 00 00 00 00 02 28 1A
					15 01 00 00 00 00 02 29 00
					15 01 00 00 00 00 02 2A 1A
					15 01 00 00 00 00 02 2B 00
					15 01 00 00 00 00 02 2D 1A

					//CMD2,Page3
					15 01 00 00 00 00 02 FF 23
					15 01 00 00 00 00 02 FB 01
					//DBV=12 bit
					15 01 00 00 00 00 02 00 80
					//PWM frequency
					15 01 00 00 00 00 02 07 00
					15 01 00 00 00 00 02 08 01
					15 01 00 00 00 00 02 09 2C

					//CMD3,PageA
					15 01 00 00 00 00 02 FF E0
					15 01 00 00 00 00 02 FB 01
					//VCOM Driving Ability
					15 01 00 00 00 00 02 14 60
					15 01 00 00 00 00 02 16 C0

					//CMD3,PageB
					15 01 00 00 00 00 02 FF F0
					15 01 00 00 00 00 02 FB 01
					//slave osc workaround
					15 01 00 00 00 00 02 3A 08

					//enable TE esd
					15 01 00 00 00 00 02 FF 27
					15 01 00 00 00 00 02 FB 01
					15 01 00 00 00 00 02 D0 33
					15 01 00 00 00 00 02 D1 84
					15 01 00 00 00 00 02 D2 30
					15 01 00 00 00 00 02 DE 43
					15 01 00 00 00 00 02 DF 02

					//CMD1
					15 01 00 00 00 00 02 FF 10
					15 01 00 00 00 00 02 FB 01
					//Only Write Slave
					15 01 00 00 00 00 02 B9 01
					//CMD2,Page0
					15 01 00 00 00 00 02 FF 20
					15 01 00 00 00 00 02 FB 01
					15 01 00 00 00 00 02 18 40

					//CMD1
					15 01 00 00 00 00 02 FF 10
					15 01 00 00 00 00 02 FB 01
					//Write Master & Slave
					15 01 00 00 00 00 02 B9 02
					15 01 00 00 00 00 02 35 00
					39 01 00 00 00 00 03 51 00 00
					15 01 00 00 00 00 02 53 2C
					39 01 00 00 00 00 03 68 02 01
					15 01 00 00 00 00 02 55 00
					15 01 00 00 00 00 02 BB 13
					//VBP+VFP=150+26=176
					39 01 00 00 00 00 06 3B 03 96 1A 04 04

					05 01 00 00 78 00 01 11
					05 01 00 00 14 00 01 29
				];
				qcom,mdss-dsi-off-command = [
					05 01 00 00 1E 00 01 28
					05 01 00 00 78 00 01 10
				];
				qcom,mdss-dsi-cabc-off-command = [
					15 01 00 00 00 00 02 FF 10
					15 01 00 00 00 00 02 FB 01
					15 01 00 00 00 00 02 B9 00//M Only
					15 01 00 00 00 00 02 55 00//CABC OFF
					15 01 00 00 00 00 02 B9 02//M_S
				];
				qcom,mdss-dsi-cabc-ui-command = [
					39 00 00 00 00 00 02 FF 10
					39 00 00 00 00 00 02 FB 01
					39 00 00 00 00 00 02 53 2C
					39 01 00 00 00 00 02 55 01
				];
				qcom,mdss-dsi-cabc-still-image-command = [
					39 00 00 00 00 00 02 FF 10
					39 00 00 00 00 00 02 FB 01
					39 00 00 00 00 00 02 53 2C
					39 01 00 00 00 00 02 55 02
				];
				qcom,mdss-dsi-cabc-video-command = [
					39 00 00 00 00 00 02 FF 10
					39 00 00 00 00 00 02 FB 01
					39 00 00 00 00 00 02 53 2C
					39 01 00 00 00 00 02 55 03
				];

				qcom,mdss-dsi-on-command-state = "dsi_hs_mode";
				qcom,mdss-dsi-off-command-state = "dsi_hs_mode";
				qcom,mdss-dsi-cabc-off-command-state = "dsi_hs_mode";
				qcom,mdss-dsi-cabc-ui-command-state = "dsi_hs_mode";
				qcom,mdss-dsi-cabc-still-image-command-state = "dsi_hs_mode";
				qcom,mdss-dsi-cabc-video-command-state = "dsi_hs_mode";
			};
		};
	};
};

&dsi_nt36523_boe_video {
	// oplus,mdss-dsi-pre-bl-delay-enabled;
	// oplus,mdss-dsi-pre-bl-delay-ms = <30>;
	oplus,mdss-dsi-cabc-enabled;
	oplus,mdss-dsi-lp-config-flag;
	oplus,lcd_switch_enabled;
	// oplus,dfps-idle-off;
	qcom,panel-supply-entries = <&dsi_panel_pwr_supply_no_labibb>;
	qcom,mdss-dsi-bl-pmic-control-type = "bl_ctrl_dcs";
	qcom,mdss-dsi-bl-min-level = <22>;
	qcom,mdss-dsi-bl-max-level = <4095>;
	qcom,mdss-brightness-max-level = <4095>;
	qcom,mdss-dsi-bl-normal-max-level = <3190>;
	qcom,mdss-brightness-normal-max-level = <3190>;
	qcom,mdss-brightness-default-level = <1825>;
	qcom,platform-te-gpio = <&tlmm 23 0>;
	qcom,dsi-select-clocks = "mux_byte_clk0", "mux_pixel_clk0",
		"src_byte_clk0", "src_pixel_clk0",
		"shadow_byte_clk0", "shadow_pixel_clk0";

	qcom,esd-check-enabled;
	qcom,mdss-dsi-panel-status-check-mode = "te_signal_check";
/*
	qcom,mdss-dsi-panel-status-command = [06 01 00 01 00 00 01 ab];
	qcom,mdss-dsi-panel-status-command-state = "dsi_lp_mode";
	qcom,mdss-dsi-panel-status-value = <0x00 0x00>;
	qcom,mdss-dsi-panel-on-check-value = <0x00 0x00>;
	qcom,mdss-dsi-panel-status-read-length = <2>;
*/
	// qcom,mdss-dsi-pan-enable-dynamic-fps;
	// qcom,mdss-dsi-pan-fps-update = "dfps_immediate_porch_mode_vfp";
	// qcom,dsi-supported-dfps-list = <120 90 60 50 48 30>;
	// qcom,mdss-dsi-qsync-min-refresh-rate = <30>;
/*
	qcom,dsi-dyn-clk-enable;
	qcom,dsi-dyn-clk-type = "constant-fps-adjust-vfp";
	qcom,dsi-dyn-clk-list = <990167040 981915648>;
*/
	oplus,dsi-brightness-remapping = <0    0>,
			<22    10>,
			<27    14>,
			<35    19>,
			<60    24>,
			<100   31>,
			<150   39>,
			<246   47>,
			<305   55>,
			<469   80>,
			<688   120>,
			<920   220>,
			<1096  315>,
			<1244  410>,
			<1373  490>,
			<1489  592>,
			<1596  693>,
			<1694  787>,
			<1786  882>,
			<1872  996>,
			<1954  1125>,
			<2032  1235>,
			<2107  1330>,
			<2178  1430>,
			<2247  1529>,
			<2313  1623>,
			<2377  1718>,
			<2440  1812>,
			<2500  1907>,
			<2559  2040>,
			<2616  2165>,
			<2671  2250>,
			<2725  2333>,
			<2750  2380>,
			<2778  2440>,
			<2830  2570>,
			<2950  2750>,
			<3050  2945>,
			<3150  3098>,
			<3190  3190>,
			<4095  4095>;

	qcom,mdss-dsi-t-clk-post = <0x0D>;
	qcom,mdss-dsi-t-clk-pre = <0x1C>;
	qcom,mdss-dsi-display-timings {
		timing@0 {
			qcom,mdss-dsi-panel-phy-timings = [00 22 08 08 19 23 09
					08 09 02 04 00 1C 0D];
			qcom,display-topology = <1 0 1>;
			qcom,default-topology-index = <0>;
		};
	};
};

&dsi_nt36523_boe_video {
	qcom,panel_voltage_vddi_name = "vddio";
	qcom,panel_voltage_vddi = <0 1650000 1800000 1950000>;
	qcom,panel_voltage_vddr_name = "vddio";
	qcom,panel_voltage_vddr = <1 1650000 1800000 1950000>;
};

