 /dts-v1/;
 /plugin/;

 #include <dt-bindings/clock/qcom,gcc-holi.h>
 #include <dt-bindings/interconnect/qcom,holi.h>
 #include <dt-bindings/interrupt-controller/arm-gic.h>
 #include <dt-bindings/regulator/qcom,rpm-smd-regulator.h>

 #include "holi-camera-pm6125-overlay.dtsi"
 #include "holi-camera.dtsi"
 #include "holi-camera-sensor-pm6125-cdp.dtsi"
 / {
	 model = "Qualcomm Technologies, Inc. Holi SoC";
	 compatible = "qcom,holi-cdp", "qcom,holi", "qcom,cdp";
	 qcom,msm-id = <472 0x10000>, <454 0x10000>;
	 qcom,board-id = <1 0>, <1 1>;
	 qcom,pmic-id-size = <4>;
	 qcom,pmic-id = <0x2D 0x0 0x2E 0x0>, <0x2D 0x0 0x0 0x0>;
 };
