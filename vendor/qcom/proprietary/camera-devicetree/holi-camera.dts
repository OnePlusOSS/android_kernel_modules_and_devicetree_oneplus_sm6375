 /dts-v1/;
 /plugin/;

 #include <dt-bindings/clock/qcom,gcc-holi.h>
 #include <dt-bindings/interconnect/qcom,holi.h>
 #include <dt-bindings/interrupt-controller/arm-gic.h>
 #include <dt-bindings/regulator/qcom,rpm-smd-regulator.h>

 #include "holi-camera.dtsi"
 / {
         model = "Qualcomm Technologies, Inc. Holi SoC";
         compatible = "qcom,holi";
         qcom,msm-id = <454 0x10000>, <472 0x10000>;
         qcom,board-id = <0 0>;
 };
