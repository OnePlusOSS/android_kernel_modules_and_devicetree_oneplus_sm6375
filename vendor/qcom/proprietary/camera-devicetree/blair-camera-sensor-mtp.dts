/dts-v1/;
/plugin/;

#include <dt-bindings/clock/qcom,gcc-blair.h>
#include <dt-bindings/interconnect/qcom,blair.h>
#include <dt-bindings/interrupt-controller/arm-gic.h>
#include <dt-bindings/regulator/qcom,rpm-smd-regulator.h>

#include "blair-camera.dtsi"
#include "blair-camera-sensor-mtp.dtsi"
/ {
	model = "Qualcomm Technologies, Inc. Blair SoC";
	compatible = "qcom,blair-mtp", "qcom,blair", "qcom,mtp";
        qcom,msm-id = <507 0x10000>, <578 0x10000>;
        qcom,board-id = <8 0>, <8 1>;
};
