/dts-v1/;
/plugin/;

#include "blair-larry-overlay-common.dtsi"
#include "blair-larry-22821-overlay.dtsi"
#include "sensor/larry-22821-sensor-qrd.dtsi"

/ {
	model = "Qualcomm Technologies, Inc. Blair QRD NOPMI";
	compatible = "qcom,blair-qrd", "qcom,blair", "qcom,qrd";
	qcom,msm-id = <507 0x10000>;
	qcom,board-id = <0x1000B 0>;
	oplus,dtsi_no = <22821>;
};

#include "camera/blair-22821-camera-sensor-mtp.dtsi"