/dts-v1/;
/plugin/;

#include "blair-mulan-a-overlay-common.dtsi"
#include "blair-mulan-a-22041-overlay.dtsi"
#include "sensor/mulan-a-22041-sensor-qrd.dtsi"
#include "nfc/mulan-a-22041-nfc-sn110.dtsi"

/ {
	model = "Qualcomm Technologies, Inc. Blair QRD NOPMI";
	compatible = "qcom,blair-qrd", "qcom,blair", "qcom,qrd";
	qcom,msm-id = <507 0x10000>;
	qcom,board-id = <0x1000B 0>;
	oplus,dtsi_no = <22041>;
};

#include "camera/blair-22041-camera-sensor-mtp.dtsi"
