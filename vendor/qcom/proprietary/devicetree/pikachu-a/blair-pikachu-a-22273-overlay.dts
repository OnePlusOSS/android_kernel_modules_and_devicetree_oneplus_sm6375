/dts-v1/;
/plugin/;

#include "blair-pikachu-a-overlay-common.dtsi"
#include "blair-pikachu-a-22273-overlay.dtsi"
#include "sensor/pikachu-a-22273-sensor-qrd.dtsi"
#include "esim/pikachu-a-22273-esim.dtsi"

/ {
	model = "Qualcomm Technologies, Inc. Blair QRD NOPMI";
	compatible = "qcom,blair-qrd", "qcom,blair", "qcom,qrd";
	qcom,msm-id = <507 0x10000>;
	qcom,board-id = <0x1000B 0>;
	oplus,dtsi_no = <22273>;
};

#include "camera/blair-22273-camera-sensor-mtp.dtsi"
#include "nfc/pikachu-a-22273-nfc-sn100f.dtsi"