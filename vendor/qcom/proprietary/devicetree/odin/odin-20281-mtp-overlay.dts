/dts-v1/;
/plugin/;

#include <dt-bindings/interrupt-controller/arm-gic.h>
#include "odin-mtp-overlay.dtsi"


/* DTBO: project Special overlay */

/ {
	model = "Qualcomm Technologies, Inc. Holi MTP";
	compatible = "qcom,holi-mtp", "qcom,holi", "qcom,mtp";
	qcom,msm-id = <454 0x10000>, <472 0x10000>;
	qcom,board-id = <8 0>;
	oplus,dtsi_no = <20281>;
};

#include "camera/odin-20281-camera-sensor-mtp.dtsi"
#include "nfc/odin-20281-nfc-mtp.dtsi"

#include "sensor/odin-20281-sensor-mtp.dtsi"