/dts-v1/;
/plugin/;

#include "blair-colombo-overlay-common.dtsi"
#include "blair-colombo-22248-overlay.dtsi"
#include "sensor/colombo-22248-sensor-qrd.dtsi"

/ {
	model = "Qualcomm Technologies, Inc. Blair QRD NOPMI";
	compatible = "qcom,blair-qrd", "qcom,blair", "qcom,qrd";
	qcom,msm-id = <507 0x10000>;
	qcom,board-id = <0x1000B 0>;
	oplus,dtsi_no = <22248>;
};

#include "nfc/colombo-22248-nfc-pn557.dtsi"
#include "camera/blair-22248-camera-sensor-mtp.dtsi"